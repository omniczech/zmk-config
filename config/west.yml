## config/west.yml
```yaml
manifest:
  remotes:
    - name: zmkfirmware
      url-base: https://github.com/omniczech/
  projects:
    - name: zmk
      remote: zmkfirmware
      revision: mouse-ftc
      import: app/west.yml
  self:
    path: config
```
